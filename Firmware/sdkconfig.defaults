## Firmware/sdkconfig.defaults
```kconfig
# AI Agent Deck V1.0 - ESP32-S3 默认配置
# Phase 1: 显示屏验证

CONFIG_IDF_TARGET_ESP32S3=y
CONFIG_ESP_DEFAULT_CPU_FREQ_MHZ=240
CONFIG_ESP32S3_DEFAULT_CPU_FREQ_240=y

# PSRAM (8MB)
CONFIG_SPIRAM=y
CONFIG_SPIRAM_MODE_OCT=y
CONFIG_SPIRAM_SPEED_80M=y

# 日志
CONFIG_ESP_CONSOLE_UART_DEFAULT=y
CONFIG_LOG_DEFAULT_LEVEL_INFO=y
CONFIG_LOG_MAXIMUM_LEVEL_VERBOSE=y

# 禁用看门狗 (开发阶段)
CONFIG_ESP_TASK_WDT=n

# UART 缓冲区增大（支持大命令接收）
CONFIG_ESP_CONSOLE_UART_RX_BUF_SIZE=1024

# Flash 8MB (DevKitC 默认)
CONFIG_ESPTOOLPY_FLASHSIZE_8MB=y
CONFIG_ESPTOOLPY_FLASHSIZE="8MB"

# BLE 支持
CONFIG_BT_ENABLED=y
CONFIG_BT_BLUEDROID_ENABLED=y
CONFIG_BT_BLE_ENABLED=y
CONFIG_BT_BLE_42_FEATURES_SUPPORTED=y
CONFIG_BT_BTU_TASK_STACK_SIZE=4096
CONFIG_ESP_IPC_TASK_STACK_SIZE=4096

# BLE MTU (增大以支持长写入)
CONFIG_BTDM_CTRL_BLE_MAX_DATA_LEN=512
CONFIG_BTDM_CTRL_BLE_MAX_MTU=512

# WiFi 支持
CONFIG_ESP_WIFI_ENABLED=y
CONFIG_ESP_WIFI_STATIC_RX_BUFFER_NUM=10
CONFIG_ESP_WIFI_DYNAMIC_RX_BUFFER_NUM=32
CONFIG_ESP_WIFI_DYNAMIC_TX_BUFFER_NUM=32

# mDNS (设备发现: ai-deck.local)
CONFIG_MDNS_ENABLED=y

# OTA 分区表 (需要 4MB+ 应用分区)
CONFIG_ESPTOOLPY_FLASHSIZE_8MB=y
CONFIG_PARTITION_TABLE_CUSTOM=y
CONFIG_PARTITION_TABLE_CUSTOM_FILENAME="partitions.csv"
CONFIG_PARTITION_TABLE_SINGLE_APP=n

# HTTP 服务器 (OTA 用)
CONFIG_HTTPD_MAX_REQ_HDR_LEN=1024
CONFIG_HTTPD_MAX_URI_LEN=512
```
